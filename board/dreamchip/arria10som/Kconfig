## board/dreamchip/arria10som/Kconfig
```kconfig
if TARGET_DREAMCHIP_ARRIA10SOM

config SYS_CPU
	default "armv7"

config SYS_BOARD
	default "arria10som"

config SYS_VENDOR
	default "dreamchip"

config SYS_SOC
	default "socfpga_arria10"

config SYS_CONFIG_NAME
	default "dreamchip_arria10som"

config UBOOT_EXE_ON_FPGA
	bool "Support socfpga_arria10_fpga"

endif
```

## board/dreamchip/wiesmann/Kconfig
```kconfig
if TARGET_WIESMANN

config SYS_CPU
	default "armv7"

config SYS_BOARD
	default "wiesmann"

config SYS_VENDOR
	default "dreamchip"

config SYS_SOC
	default "wiesmann"

config SYS_CONFIG_NAME
	default "wiesmann"

config UBOOT_EXE_ON_FPGA
	bool "Support socfpga_arria10_fpga"

config MMC_DNX_BOOT
	bool "Use TES D/AVE NX config"

endif
```

## configs/dreamchip_arria10som_qspi_defconfig
```kconfig
+S:CONFIG_ARM=y
+S:CONFIG_TARGET_DREAMCHIP_ARRIA10SOM=y
CONFIG_OF_CONTROL=y
CONFIG_DEFAULT_DEVICE_TREE="dreamchip_arria10som_qspi"
CONFIG_SKIP_LOWLEVEL_INIT=n
CONFIG_CADENCE_QSPI=y
CONFIG_MMC=y
```

## configs/dreamchip_arria10som_sdmmc_defconfig
```kconfig
+S:CONFIG_ARM=y
+S:CONFIG_TARGET_DREAMCHIP_ARRIA10SOM=y
CONFIG_OF_CONTROL=y
CONFIG_DEFAULT_DEVICE_TREE="dreamchip_arria10som_sdmmc"
CONFIG_SKIP_LOWLEVEL_INIT=n
CONFIG_CADENCE_QSPI=n
CONFIG_MMC=y
```

## configs/socfpga_arria10_dnx_defconfig
```kconfig
+S:CONFIG_ARM=y
+S:CONFIG_TARGET_SOCFPGA_ARRIA10=y
CONFIG_OF_CONTROL=y
CONFIG_DEFAULT_DEVICE_TREE="socfpga_arria10_dnx"
CONFIG_SKIP_LOWLEVEL_INIT=n
CONFIG_CADENCE_QSPI=n
CONFIG_MMC=y
CONFIG_ENV_SIZE=2048
CONFIG_BOOTDELAY=2
CONFIG_MMC_DNX_BOOT=y
CONFIG_CMD_EXT4=y
```

## configs/wiesmann_dnx_defconfig
```kconfig
+S:CONFIG_ARM=y
+S:CONFIG_TARGET_WIESMANN=y
CONFIG_OF_CONTROL=y
CONFIG_DEFAULT_DEVICE_TREE="wiesmann_dnx"
CONFIG_SKIP_LOWLEVEL_INIT=n
CONFIG_CADENCE_QSPI=y
CONFIG_MMC=y
CONFIG_ENV_SIZE=2048
CONFIG_BOOTDELAY=2
CONFIG_CMD_EXT4=y
CONFIG_DNX_BOOT=y
```
